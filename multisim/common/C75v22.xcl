-carm
-Z(CODE)Menu_Hook=0xA04A142C-FFFFFFFF /* перехват вызова меню */
-Z(CODE)csa1=0xA0A17B4C-FFFFFFFF /* перехват обращения к сим 1 */
-Z(CODE)csa2=0xA0A17F00-FFFFFFFF /* перехват обращения к сим 2 */
-Z(CODE)Msg_dispatch=0xA0A30EEC-FFFFFFFF /* перехват ответа */
-Z(CODE)SetHTTPProfile=0xA082AF7C-FFFFFFFF /* сохранение HTTP-профиля */
-Z(CODE)SetSMSProfile=0xA07F4490-FFFFFFFF /* сохранение SMS-профиля */
-Z(CONST)DATA_I,DATA_ID,INITTAB=0xA00D0000-FFFFFFFF
-Z(CONST)DATA_C,DATA_Z=0xA00D0000-FFFFFFFF
-Z(CODE)CODE=0xA00D0000-FFFFFFFF
