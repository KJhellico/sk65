-carm
-Z(CODE)Menu_Hook=0xA0943738-FFFFFFFF /* перехват вызова меню */
-Z(CODE)csa1=0xA13475E4-FFFFFFFF /* перехват обращения к сим 1 */
-Z(CODE)csa2=0xA1347998-FFFFFFFF /* перехват обращения к сим 2 */
-Z(CODE)Msg_dispatch=0xA1348208-FFFFFFFF /* перехват ответа */
-Z(CODE)SetHTTPProfile=0xA0CD1164-FFFFFFFF /* сохранение HTTP-профиля */
-Z(CODE)SetSMSProfile=0xA0BAA1A8-FFFFFFFF /* сохранение SMS-профиля */
-Z(CONST)DATA_I,DATA_ID,INITTAB=0xA00D0000-FFFFFFFF
-Z(CONST)DATA_C,DATA_Z=0xA00D0000-FFFFFFFF
-Z(CODE)CODE=0xA00D0000-FFFFFFFF
