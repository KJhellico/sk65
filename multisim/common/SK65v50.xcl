-carm
-Z(CODE)Menu_Hook=0xA045EA34-FFFFFFFF /* перехват вызова меню */
-Z(CODE)csa1=0xA09494C4-FFFFFFFF /* перехват обращения к сим 1 */
-Z(CODE)csa2=0xA0949878-FFFFFFFF /* перехват обращения к сим 2 */
-Z(CODE)Msg_dispatch=0xA0997918-FFFFFFFF /* перехват ответа */
-Z(CODE)SetHTTPProfile=0xA07B3618-FFFFFFFF /* сохранение HTTP-профиля */
-Z(CODE)SetSMSProfile=0xA07655C8-FFFFFFFF /* сохранение SMS-профиля */
-Z(CONST)DATA_I,DATA_ID,INITTAB=0xA00D0000-FFFFFFFF
-Z(CONST)DATA_C,DATA_Z=0xA00D0000-FFFFFFFF
-Z(CODE)CODE=0xA00D0000-FFFFFFFF
