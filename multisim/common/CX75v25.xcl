-carm
-Z(CODE)Menu_Hook=0xA04B1A30-FFFFFFFF /* перехват вызова меню */
-Z(CODE)csa1=0xA0A87DE4-FFFFFFFF /* перехват обращения к сим 1 */
-Z(CODE)csa2=0xA0A8819C-FFFFFFFF /* перехват обращения к сим 2 */
-Z(CODE)Msg_dispatch=0xA0AB1CF0-FFFFFFFF /* перехват ответа */
-Z(CODE)SetHTTPProfile=0xA0881E0C-FFFFFFFF /* сохранение HTTP-профиля */
-Z(CODE)SetSMSProfile=0xA083BF14-FFFFFFFF /* сохранение SMS-профиля */
-Z(CONST)DATA_I,DATA_ID,INITTAB=0xA00D0000-FFFFFFFF
-Z(CONST)DATA_C,DATA_Z=0xA00D0000-FFFFFFFF
-Z(CODE)CODE=0xA00D0000-FFFFFFFF
